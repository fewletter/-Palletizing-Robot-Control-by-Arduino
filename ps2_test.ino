#include <avr/pgmspace.h>
#include "PS2X_lib.h"
#include <Adafruit_PWMServoDriver.h>

Adafruit_PWMServoDriver pwm = Adafruit_PWMServoDriver();
/*伺服馬達脈波寬度*/
int sg90[] = {500, 2400};
int spt5435[] = {500, 2500};
int s3003[] = {500, 2400};
/*要轉的角度*/
int servo_angle_degree[] = {0, 180};

float pulse_wide;
float pulse_output;

int frequency = 50;

PS2X ps2x;
int error;

/*宣告在陣列內的位置*/
int v = 0;
int v_origin = 0;
int h = 60;
int h_origin = 60;

int dc = 0;
int dt = 0;
/*宣告伺服馬達角度*/
int angle = 60;
int angler = 90;
float where[2] = {0, 0};
float whereo[2] = {0, 0};
float calld1;
float calld2;
int anglecc = 0;
int anglec = 80;
/*宣告剛開始的運動速度*/
int s = 2;

/*手臂伺服馬達旋轉(切分訊號)*/
void mearm_run(int i, float angle1, float angle2, int servo_type_min, int servo_type_max) {
  for (int c = 1; c < 11; c++) {
    pulse_wide = map(angle2 + c * (angle1 - angle2) / 10, servo_angle_degree[0], servo_angle_degree[1], servo_type_min, servo_type_max);
    pulse_output = int(float(pulse_wide) / 1000000 * frequency * 4096);
    pwm.setPWM(i, 0, pulse_output);
    delayMicroseconds(500);
  }
}

void mearm_run_delay(int i, float angle1, float angle2, int servo_type_min, int servo_type_max) {
  for (int c = 1; c < 11; c++) {
    pulse_wide = map(angle2 + c * (angle1 - angle2) / 10, servo_angle_degree[0], servo_angle_degree[1], servo_type_min, servo_type_max);
    pulse_output = int(float(pulse_wide) / 1000000 * frequency * 4096);
    pwm.setPWM(i, 0, pulse_output);
    delay(300);
  }
}

/*其他部分伺服馬達旋轉(不切分訊號)*/
void other_run(int i, float angle1, int servo_type_min, int servo_type_max) {
  pulse_wide = map(angle1, servo_angle_degree[0], servo_angle_degree[1], servo_type_min, servo_type_max);
  pulse_output = int(float(pulse_wide) / 1000000 * frequency * 4096);
  pwm.setPWM(i, 0, pulse_output);
}
/*找出前一步*/
float origin_position(int left_back_forward, int right_up_down, int v, int h) {
  if (left_back_forward < 64 && right_up_down < 64) {
    v_origin = v - s;
    h_origin = h + s;
  }
  else if (left_back_forward < 64 && right_up_down > 191) {
    v_origin = v - s;
    h_origin = h - s;
  }
  else if (left_back_forward < 64 && right_up_down < 191 && right_up_down > 64) {
    v_origin = v - s;
    h_origin = h;
  }
  else if (left_back_forward > 191 && right_up_down > 191) {
    v_origin = v + s;
    h_origin = h - s;
  }
  else if (left_back_forward > 191 && right_up_down < 64 ) {
    v_origin = v + s;
    h_origin = h + s;
  }
  else if (left_back_forward > 191 && right_up_down < 191 && right_up_down > 64) {
    v_origin = v + s;
    h_origin = h;
  }
  else if (right_up_down > 191 && left_back_forward < 191 && left_back_forward > 64) {
    v_origin = v;
    h_origin = h - s;
  }
  else if (right_up_down < 64 && left_back_forward < 191 && left_back_forward > 64) {
    v_origin = v;
    h_origin = h + s;
  }

  return v_origin, h_origin;
}

void setup() {
  Serial.begin(9600);
  pwm.begin();
  pwm.setPWMFreq(frequency);
  //配對接收器
  do {
    error = ps2x.config_gamepad(13, 11, 10, 12, true, true);   //13 11 10 12 (1-13 2-10 3-3.3v 4-gnd 5-11 6-12)
    if (error == 0) {
      Serial.print("Gamepad found!");
      break;
    }
    else {
      delay(100);
    }
  } while (1);
}

const PROGMEM float degree1[70][95] = {
  {1.1784,  3.6109, 9.4173, 38.3626,  85.6963,  116.0562, 132.9326, 142.8072, 148.9881, 153.07, 155.87, 158.67, 160.527,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  105.8687, 103.7502},
  {15.3468, 22.3802,  36.8133,  72.9245,  88.0093,  99.8253,  115.531,  127.734,  136.2886, 142.2844, 146.5725, 150.4901, 153.2659,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 105.1759, 103.0591},
  {28.4915, 38.8315,  56.6004,  80.5715,  87.6655,  94.7754,  106.3995, 117.4417, 126.3339, 133.1405, 138.3035, 142.9591, 146.4281,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 104.4592, 102.3408},
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  {38.7271, 39.5695,  40.3313,  40.6048,  40.4551,  40.4277,  40.7017,  41.17,  41.7416,  42.3658,  43.0156,  43.7819,  44.5268,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  180,  180},
};

const PROGMEM float degree2[70][95] = {
  {180,  180,  180,  180,  180,  151.8703, 134.1221, 123.2292, 115.9524, 110.7295, 106.76, 102.7905, 99.7394,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 18.1076,  15.9638},
  {180, 180,  180,  180,  179.2413, 166.9921, 150.6336, 137.5838, 128.0574, 121.0111, 115.6215, 110.604,  106.6852,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  18.717, 16.561},
  {180, 180,  180,  180,  178.3393, 170.8207, 158.6591, 146.9222, 137.1958, 129.4508, 123.2753, 117.6058, 113.0606,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  19.3018,  17.1305},
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  {133.5489,  132.7614, 131.9552, 131.0167, 130.4766, 129.9211, 129.1291, 128.2679, 127.3888, 126.5024, 125.6097, 124.7917, 123.9446,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  180,  180},
};
/*(h,v)*/
float get_degree1(int x, int y) {
  calld1 = pgm_read_float(degree1[0] + 95 * y + x);
  return calld1;
}

float get_degree2(int x, int y) {
  calld2 = pgm_read_float(degree2[0] + 95 * y + x);
  return calld2;
}

void loop() {
  ps2x.read_gamepad(false, 0);  //讀取手把狀態
  int ds = 50;
  if (ps2x.Button(PSB_START)) {       //Start鍵
    Serial.println("Start is being held");
    delay(ds);
  }
  if (ps2x.Button(PSB_SELECT)) {     //Select鍵
    Serial.println("Select is being held");
    delay(ds);
  }
  if (ps2x.Button(PSB_PAD_UP)) {     //十字方向，上
    Serial.print("Up held this hard: ");
    Serial.println(ps2x.Analog(PSAB_PAD_UP), DEC);
    s = 5;
  }
  if (ps2x.Button(PSB_PAD_RIGHT)) { //十字方向，右
    Serial.print("Right held this hard: ");
    Serial.println(ps2x.Analog(PSAB_PAD_RIGHT), DEC);
    s = 4;
  }
  if (ps2x.Button(PSB_PAD_LEFT)) {  //十字方向，左
    Serial.print("LEFT held this hard: ");
    Serial.println(ps2x.Analog(PSAB_PAD_LEFT), DEC);
    s = 1;
  }
  if (ps2x.Button(PSB_PAD_DOWN)) {  //十字方向，下
    Serial.print("DOWN held this hard: ");
    Serial.println(ps2x.Analog(PSAB_PAD_DOWN), DEC);
    s = 2;
  }
  if (ps2x.NewButtonState(PSB_L3)) { //L3鍵
    Serial.println("L3 pressed");
    delay(ds);
  }
  if (ps2x.NewButtonState(PSB_R3)) { //R3鍵
    Serial.println("R3 pressed");
    delay(ds);
  }
  /*L2 R2 轉盤 5號*/
  other_run(5, anglec, s3003[0], s3003[1]);
  if (ps2x.NewButtonState(PSB_L2)) { //L2鍵
    if (anglec <= 0) {
      anglec = 0;
    }
    else {
      anglec -= 5;
    }
    other_run(5, anglec, 450, 2700);
    /*clipservo.write(dc);*/
    Serial.println("L2 pressed");
    Serial.print("The anglec right now is");
    Serial.println(anglec);
    delay(1);
  }
  if (ps2x.NewButtonState(PSB_R2)) { //R2鍵
    if (anglec >= 180) {
      anglec = 180;
    }
    else {
      anglec += 5;
    }
    other_run(5, anglec, 450, 2700);
    Serial.println("R2 pressed");
    Serial.print("The anglec right now is");
    Serial.println(anglec);
    delay(1);
  }
  /*夾爪轉動 8號*/
  other_run(8, angler, 550, 2500);
  if (ps2x.NewButtonState(PSB_TRIANGLE)) { //三角按鍵
    Serial.println("Triangle pressed");
    if (angler >= 190) {
      angler = 190;
    }
    else {
      angler += 10;
    }
    other_run(8, angler, 550, 2500);
    Serial.print("The angler right now is");
    Serial.println(angler);
    delay(50);
  }
  if (ps2x.NewButtonState(PSB_CIRCLE)) {  //圓型按鍵
    Serial.println("Circle pressed");
    if (angler <= 0) {
      angler = 0;
    }
    else {
      angler -= 10;
    }
    other_run(8, angler, 550, 2500);
    Serial.print("The angler right now is");
    Serial.println(angler);
    delay(50);
    delay(ds);
  }
  /*夾爪夾取 9號*/
  if (ps2x.NewButtonState(PSB_CROSS)) {  //X按鍵
    Serial.println("X pressed");
    if (angle <= 4) {
      angle = 4;
    }
    else {
      angle -= 5;
    }
    other_run(9, angle, 550, 2400);
    Serial.print("The angle right now is");
    Serial.println(angle);
    delay(5);
  }
  if (ps2x.NewButtonState(PSB_SQUARE)) { //方型按鍵
    Serial.println("Square pressed");
    if (angle >= 60) {
      angle = 60;
    }
    else {
      angle += 5;
    }
    other_run(9, angle, 550, 2400);
    Serial.print("The angle right now is");
    Serial.println(angle);
    delay(5);
  }
  where[0] = get_degree1(h, v);
  where[1] = get_degree2(h, v);
  whereo[0] = get_degree1(h_origin, v_origin);
  whereo[1] = get_degree2(h_origin, v_origin);
  mearm_run(1, where[0], whereo[0], spt5435[0], spt5435[1]);
  mearm_run(2, where[1], whereo[1], spt5435[0], spt5435[1]);
  if (ps2x.Button(PSB_L1) || ps2x.Button(PSB_R1)) { //按下L1或R1鍵，顯示兩個香菇頭的數值
    Serial.print("Stick Values:");
    Serial.print(ps2x.Analog(PSS_LY), DEC);//左，上下
    Serial.print(",");
    Serial.print(ps2x.Analog(PSS_LX), DEC);   //左，左右
    Serial.print(",");
    Serial.print(ps2x.Analog(PSS_RY), DEC);   //右，上下
    Serial.print(",");
    Serial.println(ps2x.Analog(PSS_RX), DEC); //右，左右
    /*讀取左邊類比訊號*/
    int lbf = ps2x.Analog(PSS_LY);
    if (lbf < 64) {
      v += s;
      if (v > 69) {
        v = 69;
      }
    }
    else if (lbf > 191) {
      v -= s;
      if (v < 0) {
        v = 0;
      }
    }
    /*讀取右邊類比訊號*/
    int rud = ps2x.Analog(PSS_RY);
    if (rud < 64) {
      h -= s;
      if (h < 0) {
        h = 0;
      }
    }
    else if (rud > 191) {
      h += s;
      if (h > 94) {
        h = 94;
      }
    }
    v_origin, h_origin = origin_position(lbf, rud, v, h);
    where[0] = get_degree1(h, v);
    where[1] = get_degree2(h, v);
    whereo[0] = get_degree1(h_origin, v_origin);
    whereo[1] = get_degree2(h_origin, v_origin);
    Serial.print("v:");
    Serial.println(v);
    Serial.print("h:");
    Serial.println(h);
    Serial.print("  ");
    Serial.print(where[0]);
    Serial.print("  ");
    Serial.println(where[1]);
    Serial.println("origin position:");
    Serial.print("  ");
    Serial.print(whereo[0]);
    Serial.print("  ");
    Serial.println(whereo[1]);
    Serial.print("v_origin:");
    Serial.println(v_origin);
    Serial.print("h_origin:");
    Serial.println(h_origin);
    if (where[1] != 180 && where[0] != 180) {
      mearm_run(1, where[0], whereo[0], spt5435[0], spt5435[1]);
      mearm_run(11, where[1], whereo[1], spt5435[0], spt5435[1]);
    }
  }
}
